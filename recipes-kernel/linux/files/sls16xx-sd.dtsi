/*
 * This program is free software; you can redistribute it and/or modify
 * it under the terms of the GNU General Public License version 2 as
 * published by the Free Software Foundation.
 */

/* IO multiplexing */
&iomuxc {
	/* SD */
    pinctrl_usdhc2: usdhc2grp {
            fsl,pins = <
                    MX6UL_PAD_NAND_RE_B__USDHC2_CLK     0x10069
                    MX6UL_PAD_NAND_WE_B__USDHC2_CMD     0x17059
                    MX6UL_PAD_NAND_DATA00__USDHC2_DATA0 0x17059
                    MX6UL_PAD_NAND_DATA01__USDHC2_DATA1 0x17059
                    MX6UL_PAD_NAND_DATA02__USDHC2_DATA2 0x17059
                    MX6UL_PAD_NAND_DATA03__USDHC2_DATA3 0x17059
            >;
    };
};

/* SD */
&usdhc2 {
	pinctrl-names = "default";
	pinctrl-0 = <&pinctrl_usdhc2>;
    disable-wp;
	status ="okay";
};
