/*
 * This program is free software; you can redistribute it and/or modify
 * it under the terms of the GNU General Public License version 2 as
 * published by the Free Software Foundation.
 */

/dts-v1/;

#include "sls16xx-base.dtsi"
#include "sls16xx-nand.dtsi"

/ {
	model = "SoMLabs SLS16Y2_792C_256R_256N_0SF";
};
