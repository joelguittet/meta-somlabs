## conf/layer.conf
```bitbake
# We have a conf and classes directory, add to BBPATH
BBPATH .= ":${LAYERDIR}"

# We have recipes-* directories, add to BBFILES
BBFILES += "${LAYERDIR}/recipes-*/*/*.bb \
    ${LAYERDIR}/recipes-*/*/*.bbappend"

BBFILE_COLLECTIONS += "somlabs"
BBFILE_PATTERN_somlabs = "^${LAYERDIR}/"
BBFILE_PRIORITY_somlabs = "10"

LAYERSERIES_COMPAT_somlabs =  "warrior"
```

## conf/machine/sls16xx.inc
```bitbake
# SoMLabs SLS16 (VisionSOM-6UL and VisionSOM-6ULL) common board definition file

include conf/machine/include/imx-base.inc
include conf/machine/include/tune-cortexa7.inc

# Compatibility with mx6 machines
MACHINEOVERRIDES =. "mx6:mx6ull:"

# u-boot and linux version
PREFERRED_PROVIDER_u-boot = "u-boot-somlabs"
PREFERRED_PROVIDER_virtual/bootloader = "u-boot-somlabs"
PREFERRED_PROVIDER_virtual/kernel = "linux-fslc-imx-somlabs"

# u-boot configurations
UBOOT_CONFIG[sd] = "somlabs_visionsom_6ull_fastboot_defconfig"
UBOOT_CONFIG[emmc] = "somlabs_visionsom_6ull_fastboot_defconfig"
UBOOT_CONFIG[nand] = "somlabs_visionsom_6ull_fastboot_defconfig"

# Console
SERIAL_CONSOLE = "115200 ttymxc0"

# Add kernel in image
IMAGE_INSTALL_append = " kernel-image kernel-devicetree kernel-modules"

# Always depend of u-boot
EXTRA_IMAGEDEPENDS += "u-boot-somlabs"

# Image types, tar.bz2 for convenience
IMAGE_FSTYPES = "tar.bz2"
```

## conf/machine/sls16y2_792c_256r_256n_1wb.conf
```bitbake
#@TYPE: Machine
#@NAME: SLS16Y2_792C_256R_256N_1WB board
#@DESCRIPTION: Machine configuration for SoMLabs SLS16Y2 (VisionSOM-6ULL) with 256MB RAM, 256MB NAND and WiFi/Bluetooth board

include sls16xx.inc

# u-boot configuration for this board
UBOOT_CONFIG ??= "nand"

# Device tree
KERNEL_DEVICETREE = "somlabs-visionsom-6ull-nand.dtb"

# WiFi and Bluetooth
MACHINE_FEATURES += "wifi bluetooth"
IMAGE_INSTALL_append = " firmware-imx-brcm"

# Image types, add UBI to flash the board
IMAGE_FSTYPES += "ubi"

# UBI settings for 256MB NAND
UBI_VOLNAME = "rootfs"
MKUBIFS_ARGS = "-F -m 2048 -e 126976 -c 5600"
UBINIZE_ARGS = "-m 2048 -p 128KiB -s 512 -O 2048"
```

## conf/machine/sls16y2_792c_512r_04ge_0sf.conf
```bitbake
#@TYPE: Machine
#@NAME: SLS16Y2_792C_512R_SD_1WB board
#@DESCRIPTION: Machine configuration for SoMLabs SLS16Y2 (VisionSOM-6ULL) with 512MB RAM and 4GB eMMC board

include sls16xx.inc

# u-boot configuration for this board
UBOOT_CONFIG ??= "emmc"

# Device tree
KERNEL_DEVICETREE = "somlabs-visionsom-6ull-emmc.dtb"

# Image types, add WIC to flash the board
IMAGE_FSTYPES += "wic"

# Single partition on eMMC
WKS_FILE = "imx-uboot.wks"
```

## conf/machine/sls16y2_792c_512r_04ge_1wb.conf
```bitbake
#@TYPE: Machine
#@NAME: SLS16Y2_792C_512R_SD_1WB board
#@DESCRIPTION: Machine configuration for SoMLabs SLS16Y2 (VisionSOM-6ULL) with 512MB RAM, 4GB eMMC and WiFi/Bluetooth board

include sls16xx.inc

# u-boot configuration for this board
UBOOT_CONFIG ??= "emmc"

# Device tree
KERNEL_DEVICETREE = "somlabs-visionsom-6ull-emmc.dtb"

# WiFi and Bluetooth
MACHINE_FEATURES += "wifi bluetooth"
IMAGE_INSTALL_append = " firmware-imx-brcm"

# Image types, add WIC to flash the board
IMAGE_FSTYPES += "img"

# Single partition on eMMC
WKS_FILE = "imx-uboot.wks"
```

## conf/machine/sls16y2_792c_512r_512n_1wb.conf
```bitbake
#@TYPE: Machine
#@NAME: SLS16Y2_792C_512R_512N_1WB board
#@DESCRIPTION: Machine configuration for SoMLabs SLS16Y2 (VisionSOM-6ULL) with 512MB RAM, 512MB NAND and WiFi/Bluetooth board

include sls16xx.inc

# u-boot configuration for this board
UBOOT_CONFIG ??= "nand"

# Device tree
KERNEL_DEVICETREE = "somlabs-visionsom-6ull-nand.dtb"

# WiFi and Bluetooth
MACHINE_FEATURES += "wifi bluetooth"
IMAGE_INSTALL_append = " firmware-imx-brcm"

# Image types, add UBI to flash the board
IMAGE_FSTYPES += "ubi"

# UBI settings for 512MB NAND
UBI_VOLNAME = "rootfs"
MKUBIFS_ARGS = "-F -m 4096 -e 253952 -c 2650"
UBINIZE_ARGS = "-m 4096 -p 256KiB -s 4096 -O 4096"
```

## conf/machine/sls16y2_792c_512r_sd_0sf.conf
```bitbake
#@TYPE: Machine
#@NAME: SLS16Y2_792C_512R_SD_1WB board
#@DESCRIPTION: Machine configuration for SoMLabs SLS16Y2 (VisionSOM-6ULL) with 512MB RAM and SD card board

include sls16xx.inc

# u-boot configuration for this board
UBOOT_CONFIG ??= "sd"

# Device tree
KERNEL_DEVICETREE = "somlabs-visionsom-6ull.dtb"

# Image types, add WIC to flash the SD card
IMAGE_FSTYPES += "wic"

# Single partition on SD card
WKS_FILE = "imx-uboot.wks"
```

## conf/machine/sls16y2_792c_512r_sd_1wb.conf
```bitbake
#@TYPE: Machine
#@NAME: SLS16Y2_792C_512R_SD_1WB board
#@DESCRIPTION: Machine configuration for SoMLabs SLS16Y2 (VisionSOM-6ULL) with 512MB RAM, SD card and WiFi/Bluetooth board

include sls16xx.inc

# u-boot configuration for this board
UBOOT_CONFIG ??= "sd"

# Device tree
KERNEL_DEVICETREE = "somlabs-visionsom-6ull.dtb"

# WiFi and Bluetooth
MACHINE_FEATURES += "wifi bluetooth"
IMAGE_INSTALL_append = " firmware-imx-brcm"

# Image types, add WIC to flash the SD card
IMAGE_FSTYPES += "wic"

# Single partition on SD card
WKS_FILE = "imx-uboot.wks"
```
